## base_external/Config.in
```kconfig
# Base external configuration
# Add your custom package options here

menu "Custom Buildroot Configuration"
source "$BR2_EXTERNAL_PROJECT_BASE_PATH/package/aesd-assignments/Config.in"
endmenu
```

## base_external/package/aesdchar_driver/Config.in
```kconfig
config BR2_PACKAGE_AESDCHAR_DRIVER
	bool "aesdchar_driver"
	help
	  Building aesdchar driver inside rootfs.
```
